## buildroot/configs/canrec_pi4_defconfig
```kconfig
# CANRec — Raspberry Pi 4 (64-bit) minimal image
# Based on upstream raspberrypi4_64_defconfig + dashcam customisations.
# Target Buildroot: 2024.11.x

# ── Architecture ──────────────────────────────────────────────────────────────
BR2_aarch64=y
BR2_cortex_a72=y

# ── Toolchain ─────────────────────────────────────────────────────────────────
BR2_TOOLCHAIN_BUILDROOT_WCHAR=y
BR2_TOOLCHAIN_BUILDROOT_GLIBC=y
BR2_KERNEL_HEADERS_6_6=y

# ── System ────────────────────────────────────────────────────────────────────
BR2_TARGET_GENERIC_HOSTNAME="canrec"
BR2_TARGET_GENERIC_ISSUE="CANRec DVR"
BR2_TARGET_GENERIC_ROOT_PASSWD=""
# udhcpc on eth0 via Buildroot-generated S41dhcp init script
BR2_SYSTEM_DHCP="eth0"

# ── Init: BusyBox (not systemd — boot speed constraint) ───────────────────────
BR2_INIT_BUSYBOX=y

# ── BusyBox: enable httpd via config fragment ─────────────────────────────────
BR2_PACKAGE_BUSYBOX_CONFIG_FRAGMENT_FILES="$(BR2_EXTERNAL_CANREC_PATH)/board/canrec/pi4/busybox-fragment.config"

# ── Linux kernel (Raspberry Pi foundation fork) ───────────────────────────────
BR2_LINUX_KERNEL=y
BR2_LINUX_KERNEL_CUSTOM_TARBALL=y
BR2_LINUX_KERNEL_CUSTOM_TARBALL_LOCATION="https://github.com/raspberrypi/linux/archive/refs/tags/stable_20241008.tar.gz"
BR2_LINUX_KERNEL_DEFCONFIG="bcm2711"
BR2_LINUX_KERNEL_DTS_SUPPORT=y
BR2_LINUX_KERNEL_INTREE_DTS_NAME="broadcom/bcm2711-rpi-4-b"
BR2_LINUX_KERNEL_CONFIG_FRAGMENT_FILES="$(BR2_EXTERNAL_CANREC_PATH)/board/canrec/pi4/kernel-fragment.config"
BR2_LINUX_KERNEL_NEEDS_HOST_OPENSSL=y
BR2_LINUX_KERNEL_NEEDS_HOST_LIBFDT=y

# ── Raspberry Pi firmware (bootloader blobs) ──────────────────────────────────
BR2_PACKAGE_RPI_FIRMWARE=y
BR2_PACKAGE_RPI_FIRMWARE_VARIANT_PI4=y

# ── WiFi AP ───────────────────────────────────────────────────────────────────
BR2_PACKAGE_HOSTAPD=y
BR2_PACKAGE_BRCMFMAC_SDIO_FIRMWARE_RPI=y
BR2_PACKAGE_BRCMFMAC_SDIO_FIRMWARE_RPI_WIFI=y

# ── Filesystem: ext4, read-only root ─────────────────────────────────────────
BR2_TARGET_ROOTFS_EXT2=y
BR2_TARGET_ROOTFS_EXT2_4=y
BR2_TARGET_ROOTFS_EXT2_SIZE="256M"

# ── Rootfs overlay (inittab, fstab, web root) ─────────────────────────────────
BR2_ROOTFS_OVERLAY="$(BR2_EXTERNAL_CANREC_PATH)/board/canrec/pi4/rootfs_overlay"

# ── Post-build / post-image scripts ───────────────────────────────────────────
BR2_ROOTFS_POST_BUILD_SCRIPT="$(BR2_EXTERNAL_CANREC_PATH)/board/canrec/pi4/post-build.sh"
BR2_ROOTFS_POST_IMAGE_SCRIPT="support/scripts/genimage.sh"
BR2_ROOTFS_POST_SCRIPT_ARGS="-c $(BR2_EXTERNAL_CANREC_PATH)/board/canrec/pi4/genimage.cfg"

# ── Host tools for SD card image creation ─────────────────────────────────────
BR2_PACKAGE_HOST_GENIMAGE=y
BR2_PACKAGE_HOST_DOSFSTOOLS=y
BR2_PACKAGE_HOST_MTOOLS=y
```
